## drivers/sensor/2smpb_02e/Kconfig
```kconfig
# Copyright (c) 2024 CATIE
# SPDX-License-Identifier: Apache-2.0

menuconfig 2SMPB_02E
    bool "OMRON 2SMPB_02E digital barometric pressure sensor"
    default y
    depends on DT_HAS_OMRON_2SMPB_02E_ENABLED
    help
      Enable driver for OMRON 2SMPB_02E digital barometric pressure sensor.
```

## drivers/sensor/Kconfig
```kconfig
# Copyright (c) 2024 CATIE
# SPDX-License-Identifier: Apache-2.0

if SENSOR

rsource "omron/Kconfig"

endif # SENSOR
```

## dts/bindings/sensor/omron,2smpb-02e.yaml
```yaml
# Copyright (c) 2024 CATIE
# SPDX-License-Identifier: Apache-2.0

description: |
    Omron 2smpb_02e digital barometric pressure sensor.

compatible: "omron,2smpb-02e"

include: [sensor-device.yaml]
```

## samples/sample.yaml
```yaml
sample:
  name: 2SMPB-02E pressure sensor sample
tests:
  sample.default:
    tags: sensor
    integration_platforms:
      - zest_core_stm32l4a6rg
    depends_on: i2c
```
